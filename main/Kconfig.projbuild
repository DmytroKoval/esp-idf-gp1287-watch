## main/Kconfig.projbuild
```kconfig
menu "Watch WiFi Configuration"

    config WIFI_SSID
        string "WiFi SSID"
        default "myssid"
        help
            SSID (network name) to connect to.

    config WIFI_PASSWORD
        string "WiFi Password"
        default "mypassword"
        help
            WiFi password (WPA2/WPA3) for the network.

    config WIFI_MAXIMUM_RETRY
        int "Maximum retry attempts"
        default 10
        help
            Maximum number of retries before giving up on WiFi connection.

endmenu

menu "Watch display"

    config NIGHT_MODE_BRIGHTNESS_THRESHOLD
        int "Night mode brightness threshold"
        range 0 600
        default 20
        help
            Enter duty mode when calculated display brightness is at or below this value.

endmenu

menu "Watch web services"

    config ALERTS_API_TOKEN
        string "alerts.in.ua API token"
        default ""
        help
            Bearer token for the alerts.in.ua IoT endpoint.

    config WEATHER_API_KEY
        string "OpenWeather API key"
        default ""
        help
            API key for the OpenWeather One Call request.

endmenu
```
